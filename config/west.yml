## config/west.yml
```yaml
manifest:
  defaults:
    revision: v0.3
  remotes:
    - name: zmkfirmware
      url-base: https://github.com/zmkfirmware
    - name: joelspadin
      url-base: https://github.com/joelspadin
    - name: schmidma
      url-base: https://github.com/schmidma
  projects:
    - name: zmk
      remote: schmidma
      revision: 233b42e908b483438b9ac4931b5a9d0372b9b126
      import: app/west.yml
    - name: zmk-locales
      remote: joelspadin
      revision: main
  self:
    path: config
```
